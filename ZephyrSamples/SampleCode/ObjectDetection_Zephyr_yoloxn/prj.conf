## CMakeLists.txt
```
# Copyright 2021-2022 Arm Limited and/or its affiliates <open-source-office@arm.com>
#
# SPDX-License-Identifier: Apache-2.0

cmake_minimum_required(VERSION 3.20.0)
find_package(Zephyr REQUIRED HINTS $ENV{ZEPHYR_BASE})
set(APP_DEVICE_DIR src/Device)
set(APP_MODEL_DIR src/Model)
set(APP_SRC_DIR src/)
set(APP_NPU_DIR src/NPU)
set(APP_PROFILER_DIR src/ProfilerCounter)
set(APP_BYTETRACK_DIR src/ByteTrack)
set(APP_EIGEN_DIR ../../ThirdParty/eigen)
set(APP_THIRDPARTY_MLEVK_DIR ../../ThirdParty/ml-embedded-evaluation-kit)
set(APP_THIRDPARTY_OMV ../../ThirdParty/openmv)

project(ObjectDetection-Zephyr-yoloxn)

target_include_directories(app PRIVATE
    ${APP_DEVICE_DIR}/include
)

target_include_directories(app PRIVATE
    ${APP_PROFILER_DIR}/include
)

target_include_directories(app PRIVATE
    ${APP_NPU_DIR}/include
)

target_include_directories(app PRIVATE
    ${APP_MODEL_DIR}/include
)

target_include_directories(app PRIVATE
    ${APP_BYTETRACK_DIR}/include
)

target_include_directories(app PRIVATE
    ${APP_EIGEN_DIR}
)

target_include_directories(app PRIVATE
    ${APP_THIRDPARTY_MLEVK_DIR}/source/application/api/common/include
    ${APP_THIRDPARTY_MLEVK_DIR}/source/log/include
    ${APP_THIRDPARTY_MLEVK_DIR}/source/profiler/include
    ${APP_THIRDPARTY_MLEVK_DIR}/source/math/include
)

target_include_directories(app PRIVATE
    ${APP_THIRDPARTY_OMV}/omv/imlib
    ${APP_THIRDPARTY_OMV}/omv/alloc
    ${APP_THIRDPARTY_OMV}/omv/common
    ${APP_THIRDPARTY_OMV}/omv/Lib
)

target_compile_definitions(app PRIVATE
    FS_FATFS_WINDOW_ALIGNMENT=32
    NVT_DCACHE_ON=1
    ARM_NPU
)

if(CONFIG_APP_OD_PROFILE_ENABLED)
    target_compile_definitions(app PRIVATE __PROFILE__)
endif()

if(CONFIG_APP_OD_UVC_SHOW_IMAGE)
    target_compile_definitions(app PRIVATE __USE_UVC__)
endif()

if(CONFIG_APP_OD_MODEL_FROM_SD)
    target_compile_definitions(app PRIVATE __LOAD_MODEL_FROM_SD__)
endif()

if(CONFIG_APP_OD_FORMATTED_MESSAGE)
    target_compile_definitions(app PRIVATE __FORMATTED_OD_MESSAGE__)
endif()

if(CONFIG_APP_OD_USING_HYPERRAM)
    target_compile_definitions(app PRIVATE __USE_HYPERRAM__)
endif()

if(CONFIG_APP_OD_LCD_SHOW_IMAGE)
    target_compile_definitions(app PRIVATE __USE_LCD__)
endif()

if(CONFIG_LT7381_MPU_PANEL)
    target_compile_definitions(app PRIVATE __LCD_LT7381_PANEL__)
endif()

if(CONFIG_FSA506_MPU_PANEL)
    target_compile_definitions(app PRIVATE __LCD_FSA506_PANEL__)
endif()

if(CONFIG_ILI9341_SPI_PANEL)
    target_compile_definitions(app PRIVATE __LCD_ILI9341_PANEL__)
endif()

if((CONFIG_APP_OD_LCD_SHOW_IMAGE) OR (CONFIG_APP_OD_UVC_SHOW_IMAGE))
    target_compile_definitions(app PRIVATE __PREVIEW_SUPPORT__)
endif()

if(CONFIG_CMOS_HM1055_SENSOR)
    target_compile_definitions(app PRIVATE __CMOS_HM1055_SENSOR__)
endif()

if(CONFIG_CMOS_GC0308_SENSOR)
    target_compile_definitions(app PRIVATE __CMOS_GC0308_SENSOR__)
endif()

if(${BOARD} STREQUAL "numaker_m55m1")
    target_compile_definitions(app PRIVATE __NUMAKER_M55M1__)
elseif(${BOARD} STREQUAL "numaker_gai_m55m1")
    target_compile_definitions(app PRIVATE __NUGESTUREAI_M55M1__)
endif()

target_sources(app PRIVATE
    ${APP_SRC_DIR}/main.cpp
    ${APP_SRC_DIR}/BoardInit.cpp
    ${APP_SRC_DIR}/ModelFileReader.c
    ${APP_SRC_DIR}/DetectorPostProcessing.cpp
    ${APP_SRC_DIR}/InferenceTask.cpp
)

target_sources(app PRIVATE
    ${APP_DEVICE_DIR}/HyperRAM/hyperram_code.c
    ${APP_DEVICE_DIR}/SDCard/sdglue.c
    ${APP_DEVICE_DIR}/SDCard/diskio_SDH.c
    ${APP_DEVICE_DIR}/ImageSensor/ImageSensor.c
    ${APP_DEVICE_DIR}/ImageSensor/Sensor/Sensor_HM1055.c
    ${APP_DEVICE_DIR}/ImageSensor/Sensor/Sensor_GC0308.c
    ${APP_DEVICE_DIR}/ImageSensor/Sensor/SWI2C.c
    ${APP_DEVICE_DIR}/UVC/UVC.c
    ${APP_DEVICE_DIR}/UVC/descriptors.c
    ${APP_DEVICE_DIR}/Display/Display.c
    ${APP_DEVICE_DIR}/Display/drv_pdma.c
    ${APP_DEVICE_DIR}/Display/Font8_16.c
    ${APP_DEVICE_DIR}/Display/LCD/LCD_LT7381.c
    ${APP_DEVICE_DIR}/Display/LCD/LCD_ILI9341.c
    ${APP_DEVICE_DIR}/Display/LCD/LCD_FSA506.c
)

target_sources(app PRIVATE
    ${APP_PROFILER_DIR}/pmu_counter.c
)

target_sources(app PRIVATE
    ${APP_NPU_DIR}/ethosu_profiler.c
)

target_sources(app PRIVATE
    ${APP_MODEL_DIR}/YoloXnanoNu.cpp
    ${APP_MODEL_DIR}/yolox_n_nu_HgPerson_full_integer_quant_vela.tflite_class12.cpp
    ${APP_MODEL_DIR}/Labels.cpp
)

target_sources(app PRIVATE
    ${APP_BYTETRACK_DIR}/BYTETracker.cpp
    ${APP_BYTETRACK_DIR}/kalmanFilter.cpp
    ${APP_BYTETRACK_DIR}/lapjv.cpp
    ${APP_BYTETRACK_DIR}/STrack.cpp
    ${APP_BYTETRACK_DIR}/utils.cpp
)

target_sources(app PRIVATE
    ${APP_THIRDPARTY_MLEVK_DIR}/source/application/api/common/source/Model.cpp
    ${APP_THIRDPARTY_MLEVK_DIR}/source/application/api/common/source/ImageUtils.cpp
    ${APP_THIRDPARTY_MLEVK_DIR}/source/application/api/common/source/TensorFlowLiteMicro.cpp
    ${APP_THIRDPARTY_MLEVK_DIR}/source/math/PlatformMath.cpp
    ${APP_THIRDPARTY_MLEVK_DIR}/source/profiler/Profiler.cpp
)

target_sources(app PRIVATE
    ${ZEPHYR_NUVOTON_MODULE_DIR}/m55m1x/StdDriver/src/spim_hyper.c
    ${ZEPHYR_NUVOTON_MODULE_DIR}/m55m1x/StdDriver/src/sdh.c
    ${ZEPHYR_NUVOTON_MODULE_DIR}/m55m1x/StdDriver/src/ccap.c
    ${ZEPHYR_NUVOTON_MODULE_DIR}/m55m1x/StdDriver/src/hsusbd.c
    ${ZEPHYR_NUVOTON_MODULE_DIR}/m55m1x/StdDriver/src/ebi.c
    ${ZEPHYR_NUVOTON_MODULE_DIR}/m55m1x/StdDriver/src/pdma.c
    ${ZEPHYR_NUVOTON_MODULE_DIR}/m55m1x/StdDriver/src/spi.c
)

target_sources(app PRIVATE
    ${ZEPHYR_FATFS_MODULE_DIR}/ff.c
    ${ZEPHYR_FATFS_MODULE_DIR}/option/ffunicode.c
)

target_link_libraries(app PRIVATE 
    ${PROJECT_SOURCE_DIR}/${APP_THIRDPARTY_OMV}/omv/Lib/libomv.a
)

# Add platform specific linker source snippet
zephyr_linker_sources(SECTIONS sram_non-cache_section.ld)
```

## Kconfig
```
menu "Object Detection Application Configurations"

config APP_OD_PROFILE_ENABLED
    bool "Application profiling enable"
    default n

config APP_OD_USING_HYPERRAM
    bool "Using hyperram for model"
    default n

config APP_OD_MODEL_FROM_SD
    bool "Load model from SD card enable"
    default n
    select APP_OD_USING_HYPERRAM

config APP_OD_UVC_SHOW_IMAGE
    bool "Show result image over UVC"
    default n

config APP_OD_FORMATTED_MESSAGE
    bool "Formatted object detection message output enable"
    default n

config APP_OD_LCD_SHOW_IMAGE
    bool "Show result image over LCD"
    default n

if APP_OD_LCD_SHOW_IMAGE

choice
    prompt "LCD select"
    default LT7381_MPU_PANEL
        
config  LT7381_MPU_PANEL
    bool "Use LT7381 panel"

config  FSA506_MPU_PANEL
    bool "Use FSA506 panel"

config  ILI9341_SPI_PANEL
    bool "Use ILI9341 panel"

endchoice

endif

choice
    prompt "Image Sensor select"
    default CMOS_HM1055_SENSOR  

config CMOS_HM1055_SENSOR
    bool "Use HM1055 sensor"

config CMOS_GC0308_SENSOR
    bool "Use GC0308 sensor"

endchoice

endmenu
source "Kconfig.zephyr"
```

## prj.conf
```kconfig
#application default configuration
CONFIG_CPP=y
CONFIG_STD_CPP17=y
# Include TFLM based on CMSIS NN optimization and ETHOSU acceleration
CONFIG_TENSORFLOW_LITE_MICRO=y
CONFIG_TENSORFLOW_LITE_MICRO_CMSIS_NN_KERNELS=y
# Enable Ethos-U support
CONFIG_ETHOS_U=y
# Disable Ethos-U D-Cache flush/invalidate operations 
CONFIG_ETHOS_U_DCACHE=n
# Set main stack size to 8 KB
CONFIG_MAIN_STACK_SIZE=8192
# Set heap memory pool size to 64 KB
CONFIG_HEAP_MEM_POOL_SIZE=65536
# Enable Floating Point Unit (FPU) support
CONFIG_FPU=y
# Enable logging subsystem
CONFIG_LOG=y
# Enable log processing thread custom priority
CONFIG_LOG_PROCESS_THREAD_CUSTOM_PRIORITY=y
# Set log processing thread priority to 2
CONFIG_LOG_PROCESS_THREAD_PRIORITY=2
# Set log buffer size to 8 KB
CONFIG_LOG_BUFFER_SIZE=8192
# Disable log backend showing level
CONFIG_LOG_BACKEND_SHOW_LEVEL=n
# Enable floating point support in printf
CONFIG_REQUIRES_FLOAT_PRINTF=y
# Set system tick frequency to 1000 Hz
CONFIG_SYS_CLOCK_TICKS_PER_SEC=1000
# Enable compiler optimizations for vectorization
CONFIG_COMPILER_OPT="-ftree-vectorize"
# Enable I/D cache
CONFIG_CACHE_MANAGEMENT=y

# Object detection application specific configurations
# Enable application profiling 
CONFIG_APP_OD_PROFILE_ENABLED=n
# Load model from SD Card to HyperRAM
CONFIG_APP_OD_MODEL_FROM_SD=n
# Show result image over UVC
CONFIG_APP_OD_UVC_SHOW_IMAGE=n
# Show result image over LCD
CONFIG_APP_OD_LCD_SHOW_IMAGE=n
# Formatted object detection message output enable
CONFIG_APP_OD_FORMATTED_MESSAGE=n
# Enable GC0308 image sensor for NuGestureAI-M55M1 board
#CONFIG_CMOS_GC0308_SENSOR=y
```

## ebi_lcd_region.overlay
```dts
#include <zephyr/dt-bindings/memory-attr/memory-attr-arm.h>

/{
    ebi0: memory@60000000 {
		compatible = "zephyr,memory-region";
        reg = <0x60000000 0x00100000>;  // 起始位址與大小
        zephyr,memory-region = "EBI0";
        zephyr,memory-attr = <DT_MEM_ARM_MPU_DEVICE>;
    };
};
```

## sram0_128K.overlay
```dts
/* SPDX-License-Identifier: Apache-2.0 */

&sram0 {
    reg = <0x20100000 DT_SIZE_K(128)>;
};
```

## sram0_64K.overlay
```dts
/* SPDX-License-Identifier: Apache-2.0 */

&sram0 {
    reg = <0x20100000 DT_SIZE_K(64)>;
};
```

## sram2_region.overlay
```dts
#include <zephyr/dt-bindings/memory-attr/memory-attr-arm.h>

/{
    sram2: memory@20200000 {
		compatible = "zephyr,memory-region";
        reg = <0x20200000 0x00050000>;  // 起始位址與大小
        zephyr,memory-region = "SRAM2";
        zephyr,memory-attr = <DT_MEM_ARM_MPU_RAM_NOCACHE>;
    };
    chosen {
        zephyr,extra-memory = &sram2;
    };
};
```

## sram_hyperram_region.overlay
```dts
#include <zephyr/dt-bindings/memory-attr/memory-attr-arm.h>

/{
	reserved-memory {
		#address-cells = <1>;
		#size-cells = <1>;
		ranges;

		sram_hyperram: memory@81F20000 {
			compatible = "zephyr,memory-region";
			reg = <0x81F20000 DT_SIZE_K(4000)>;  // Start address and size
			zephyr,memory-region = "SRAM_HYPERRAM";
	        zephyr,memory-attr = <DT_MEM_ARM_MPU_RAM_NOCACHE>;
		};
	};

	chosen {
        zephyr,extra-memory = &sram_hyperram;
    };
};
```

## sram_non-cache_region.overlay
```dts
#include <zephyr/dt-bindings/memory-attr/memory-attr-arm.h>

/{
	reserved-memory {
		#address-cells = <1>;
		#size-cells = <1>;
		ranges;

		sram_non_cache: memory@20120000 {
			compatible = "zephyr,memory-region";
			reg = <0x20120000 DT_SIZE_K(1216)>;  // Start address and size
			zephyr,memory-region = "SRAM_NON_CACHE";
	        zephyr,memory-attr = <DT_MEM_ARM_MPU_RAM_NOCACHE>;
		};
	};

	chosen {
        zephyr,extra-memory = &sram_non_cache;
    };
};
```

## src/BoardInit.cpp
```c
/**************************************************************************//**
 * @file     BoardInit.cpp
 * @version  V1.00
 * @brief    Target board initiate function
 *
 * @copyright SPDX-License-Identifier: Apache-2.0
 * @copyright Copyright (C) 2023 Nuvoton Technology Corp. All rights reserved.
 ******************************************************************************/
#include <cstdio>

#include "NuMicro.h"
#include "hyperram_code.h"

#define DESIGN_NAME "M55M1"
#define HYPERRAM_SPIM_PORT SPIM0        //For NuMaker-M55M1 board

#if defined(__LOAD_MODEL_FROM_SD__)
static void SDCard0_PinConfig(void)
{
	/* Set multi-function pin for SDH */
    SET_SD0_nCD_PD13();
    SET_SD0_CLK_PE6();
    SET_SD0_CMD_PE7();
    SET_SD0_DAT0_PE2();
    SET_SD0_DAT1_PE3();
    SET_SD0_DAT2_PE4();
    SET_SD0_DAT3_PE5();
}

static void SDCard1_PinConfig(void)
{
	/* Set multi-function pin for SDH */
    SET_SD1_nCD_PA6();
    SET_SD1_CLK_PB6();
    SET_SD1_CMD_PA5();
    SET_SD1_DAT0_PA8();
    SET_SD1_DAT1_PA9();
    SET_SD1_DAT2_PA10();
    SET_SD1_DAT3_PA11();
}
#endif

static void SYS_Init(void)
{
    /* Enable APLL1 clock */
    CLK_EnableAPLL(CLK_APLLCTL_APLLSRC_HXT, FREQ_220MHZ, CLK_APLL1_SELECT);

   /* Update System Core Clock */
    /* User can use SystemCoreClockUpdate() to calculate SystemCoreClock. */
    SystemCoreClockUpdate();

    /* Enable GPIO module clock */
    CLK_EnableModuleClock(GPIOA_MODULE);
    CLK_EnableModuleClock(GPIOB_MODULE);
    CLK_EnableModuleClock(GPIOC_MODULE);
    CLK_EnableModuleClock(GPIOD_MODULE);
    CLK_EnableModuleClock(GPIOE_MODULE);
    CLK_EnableModuleClock(GPIOF_MODULE);
    CLK_EnableModuleClock(GPIOG_MODULE);
    CLK_EnableModuleClock(GPIOH_MODULE);
    CLK_EnableModuleClock(GPIOI_MODULE);
    CLK_EnableModuleClock(GPIOJ_MODULE);

    /* Enable FMC0 module clock to keep FMC clock when CPU idle but NPU running*/
    CLK_EnableModuleClock(FMC0_MODULE);

    /* Enable NPU module clock */
    CLK_EnableModuleClock(NPU0_MODULE);

#if defined(__LOAD_MODEL_FROM_SD__)
#if defined(__NUMAKER_M55M1__)
/* Enable SDH0 module clock source as HCLK and SDH0 module clock divider as 4 */
    CLK_SetModuleClock(SDH0_MODULE, CLK_SDHSEL_SDH0SEL_APLL1_DIV2, CLK_SDHDIV_SDH0DIV(5));
    CLK_EnableModuleClock(SDH0_MODULE);
#endif

#if defined(__NUGESTUREAI_M55M1__)
/* Enable SDH1 module clock source as HCLK and SDH1 module clock divider as 4 */
    CLK_SetModuleClock(SDH1_MODULE, CLK_SDHSEL_SDH1SEL_APLL1_DIV2, CLK_SDHDIV_SDH1DIV(5));
    CLK_EnableModuleClock(SDH1_MODULE);
#endif
#endif

    /* Enable CCAP0 module clock */
    CLK_EnableModuleClock(CCAP0_MODULE);

#if defined(__USE_HYPERRAM__)
    HyperRAM_PinConfig(HYPERRAM_SPIM_PORT);
#endif

#if defined(__LOAD_MODEL_FROM_SD__)
#if defined(__NUMAKER_M55M1__)
    SDCard0_PinConfig();
#endif
#if defined(__NUGESTUREAI_M55M1__)
    SDCard1_PinConfig();
#endif
#endif
}

/**
  * @brief Initiate the hardware resources of board
  * @return 0: Success, <0: Fail
  * @details Initiate clock, UART, NPU, hyperflash/hyperRAM
  * \hideinitializer
  */
int BoardInit(void)
{
    /* Unlock protected registers */
    SYS_UnlockReg();

    SYS_Init();
    SYS_LockReg();                   /* Unlock register lock protect */

#if defined(__USE_HYPERRAM__)
    HyperRAM_Init(HYPERRAM_SPIM_PORT);
    /* Enter direct-mapped mode to run new applications */
    SPIM_HYPER_EnterDirectMapMode(HYPERRAM_SPIM_PORT);
#endif

#if defined(__LOAD_MODEL_FROM_SD__)
    /* SDH open SD card*/
#if defined(__NUMAKER_M55M1__)
    SDH_Open_Disk(SDH0, CardDetect_From_GPIO);
#endif

#if defined(__NUGESTUREAI_M55M1__)
    SDH_Open_Disk(SDH1, CardDetect_From_GPIO);
#endif

#endif

    printf("%s: complete\n", __FUNCTION__);

    /* Print target design info */
    printf("Target system: %s\n", DESIGN_NAME);

    return 0;
}
```

## src/DetectionResult.hpp
```c
/*
 * Copyright (c) 2022 Arm Limited. All rights reserved.
 * SPDX-License-Identifier: Apache-2.0
 *
 * Licensed under the Apache License, Version 2.0 (the "License");
 * you may not use this file except in compliance with the License.
 * You may obtain a copy of the License at
 *
 *     http://www.apache.org/licenses/LICENSE-2.0
 *
 * Unless required by applicable law or agreed to in writing, software
 * distributed under the License is distributed on an "AS IS" BASIS,
 * WITHOUT WARRANTIES OR CONDITIONS OF ANY KIND, either express or implied.
 * See the License for the specific language governing permissions and
 * limitations under the License.
 */
#ifndef DETECTION_RESULT_HPP
#define DETECTION_RESULT_HPP


namespace arm
{
namespace app
{
namespace object_detection
{

/**
 * @brief   Class representing a single detection result.
 */
class DetectionResult
{
public:
    /**
     * @brief       Constructor
     * @param[in]   normalisedVal   Result normalized value
     * @param[in]   x0              Top corner x starting point
     * @param[in]   y0              Top corner y starting point
     * @param[in]   w               Detection result width
     * @param[in]   h               Detection result height
     * @param[in]   cls             Detection class number
     **/
    DetectionResult(double normalisedVal, int x0, int y0, int w, int h, int cls) :
        m_normalisedVal(normalisedVal),
        m_x0(x0),
        m_y0(y0),
        m_w(w),
        m_h(h),
        m_cls(cls),
        m_trackID(0)
    {
    }

    DetectionResult() = default;
    ~DetectionResult() = default;

    double  m_normalisedVal{0.0};
    int     m_x0{0};
    int     m_y0{0};
    int     m_w{0};
    int     m_h{0};
    int     m_cls{0};
    int     m_trackID{0};
};

} /* namespace object_detection */
} /* namespace app */
} /* namespace arm */

#endif /* DETECTION_RESULT_HPP */
```

## src/DetectorPostProcessing.cpp
```c
/*
 * Copyright (c) 2022 Arm Limited. All rights reserved.
 * SPDX-License-Identifier: Apache-2.0
 *
 * Licensed under the Apache License, Version 2.0 (the "License");
 * you may not use this file except in compliance with the License.
 * You may obtain a copy of the License at
 *
 *     http://www.apache.org/licenses/LICENSE-2.0
 *
 * Unless required by applicable law or agreed to in writing, software
 * distributed under the License is distributed on an "AS IS" BASIS,
 * WITHOUT WARRANTIES OR CONDITIONS OF ANY KIND, either express or implied.
 * See the License for the specific language governing permissions and
 * limitations under the License.
 */
#include "DetectorPostProcessing.hpp"
#include "PlatformMath.hpp"
#include "log_macros.h"      /* Logging macros (optional) */

#include <cmath>

namespace arm
{
namespace app
{
namespace object_detection
{

DetectorPostprocessing::DetectorPostprocessing(
    const float threshold,
    const float nms,
    int numClasses,
    int topN)
    :   m_threshold(threshold),
        m_nms(nms),
        m_numClasses(numClasses),
        m_topN(topN)
{}

void DetectorPostprocessing::RunPostProcessing(
    uint32_t imgNetRows,
    uint32_t imgNetCols,
    uint32_t imgSrcRows,
    uint32_t imgSrcCols,
    TfLiteTensor *modelOutput0,
    std::vector<DetectionResult> &resultsOut    /* init postprocessing */
)
{
#if defined (__ICCARM__)
    Network net;
    net.inputWidth = static_cast<int>(imgNetCols);
    net.inputHeight = static_cast<int>(imgNetRows);
    net.numClasses = m_numClasses;


    Branch branches0;
    branches0.resolution = modelOutput0->dims->data[1];
    branches0.modelOutput = modelOutput0->data.int8;
    branches0.scale = ((TfLiteAffineQuantization *)(modelOutput0->quantization.params))->scale->data[0];
    branches0.zeroPoint = ((TfLiteAffineQuantization *)(modelOutput0->quantization.params))->zero_point->data[0];
    branches0.size = modelOutput0->bytes;

    net.branches.push_back(branches0);

    net.topN = m_topN;
#else
    Network net
    {
        .inputWidth = static_cast<int>(imgNetCols),
        .inputHeight = static_cast<int>(imgNetRows),
        .numClasses = m_numClasses,
        .branches = {
            Branch {
                .resolution = modelOutput0->dims->data[1],
                .modelOutput = modelOutput0->data.int8,
                .scale = ((TfLiteAffineQuantization *)(modelOutput0->quantization.params))->scale->data[0],
                .zeroPoint = ((TfLiteAffineQuantization *)(modelOutput0->quantization.params))->zero_point->data[0],
                .size = modelOutput0->bytes
            }
        },
        .topN = m_topN
    };
#endif
    /* End init */

    /* Start postprocessing */
    int originalImageWidth = imgSrcCols;
    int originalImageHeight = imgSrcRows;

    std::forward_list<image::Detection> detections;
    GetNetworkBoxes(net, originalImageWidth, originalImageHeight, m_threshold, detections);

    /* Do nms */
    CalculateNMS(detections, net.numClasses, m_nms);

    for (auto &it : detections)
    {

        // transfer to original img size (base on resize ratio)
        it.bbox.x = (it.bbox.x * originalImageWidth) / net.inputWidth;
        it.bbox.y = (it.bbox.y * originalImageHeight) / net.inputHeight;
        it.bbox.w = (it.bbox.w * originalImageWidth) / net.inputWidth;
        it.bbox.h = (it.bbox.h * originalImageHeight) / net.inputHeight;

        float xMin = it.bbox.x - it.bbox.w / 2.0f;
        float xMax = it.bbox.x + it.bbox.w / 2.0f;
        float yMin = it.bbox.y - it.bbox.h / 2.0f;
        float yMax = it.bbox.y + it.bbox.h / 2.0f;

        if (xMin < 0)
        {
            xMin = 0;
        }

        if (yMin < 0)
        {
            yMin = 0;
        }

        if (xMax > originalImageWidth)
        {
            xMax = originalImageWidth;
        }

        if (yMax > originalImageHeight)
        {
            yMax = originalImageHeight;
        }

        float boxX = xMin;
        float boxY = yMin;
        float boxWidth = xMax - xMin;
        float boxHeight = yMax - yMin;

        for (int j = 0; j < net.numClasses; ++j)
        {
            if (it.prob[j] > 0)
            {

                DetectionResult tmpResult = {};
                tmpResult.m_normalisedVal = it.prob[j];
                tmpResult.m_x0 = (int)boxX;
                tmpResult.m_y0 = (int)boxY;
                tmpResult.m_w = (int)boxWidth;
                tmpResult.m_h = (int)boxHeight;
                tmpResult.m_cls = j;

                resultsOut.push_back(tmpResult);
            }
        }
    }

#if defined (__ICCARM__)
    net.branches.erase(net.branches.begin(), net.branches.end());
#endif
}


void DetectorPostprocessing::InsertTopNDetections(std::forward_list<image::Detection> &detections, image::Detection &det)
{
    std::forward_list<image::Detection>::iterator it;
    std::forward_list<image::Detection>::iterator last_it;

    for (it = detections.begin(); it != detections.end(); ++it)
    {
        if (it->objectness > det.objectness)
            break;

        last_it = it;
    }

    if (it != detections.begin())
    {
        detections.emplace_after(last_it, det);
        detections.pop_front();
    }
}

void DetectorPostprocessing::GetNetworkBoxes(Network &net, int imageWidth, int imageHeight, float threshold, std::forward_list<image::Detection> &detections)
{
    auto det_objectness_comparator = [](image::Detection & pa, image::Detection & pb)
    {
        return pa.objectness < pb.objectness;
    };

    const float strides[] = {8, 16, 32};
    std::vector<int> hsizes;
    std::vector<int> wsizes;

    for (int stride : strides)
    {
        hsizes.push_back(net.inputHeight / stride); //[40, 20 ,8]
        wsizes.push_back(net.inputWidth / stride);
    }

    int section0_1d = hsizes[0] * wsizes[0]; // 40*40
    int section1_1d = hsizes[0] * wsizes[0] + hsizes[1] * wsizes[1]; // 40*40 + 20*20


    int numClasses = net.numClasses;
    int num = 0;

    for (int i = 0; i < net.branches[0].resolution; ++i)
    {
        int bbox_obj_offset = i * (numClasses + 5) + 4;
        int bbox_scr_offset = i * (numClasses + 5) + 5;
        float objectness = (static_cast<float>(net.branches[0].modelOutput[bbox_obj_offset]) - net.branches[0].zeroPoint) * net.branches[0].scale;

        if (objectness > threshold) // if obj < threshold, there is no way score*obj > threshold. because score, obj: [0, 1)
        {
            image::Detection det;
            int bbox_x_offset = i * (numClasses + 5);
            int bbox_y_offset = bbox_x_offset + 1;
            int bbox_w_offset = bbox_x_offset + 2;
            int bbox_h_offset = bbox_x_offset + 3;

            det.bbox.x = (static_cast<float>(net.branches[0].modelOutput[bbox_x_offset]) - net.branches[0].zeroPoint) * net.branches[0].scale;
            det.bbox.y = (static_cast<float>(net.branches[0].modelOutput[bbox_y_offset]) - net.branches[0].zeroPoint) * net.branches[0].scale;
            det.bbox.w = (static_cast<float>(net.branches[0].modelOutput[bbox_w_offset]) - net.branches[0].zeroPoint) * net.branches[0].scale;
            det.bbox.h = (static_cast<float>(net.branches[0].modelOutput[bbox_h_offset]) - net.branches[0].zeroPoint) * net.branches[0].scale;

            // yolox-n
            if (i < section0_1d)
            {
                det.bbox.x = (det.bbox.x + (i % wsizes[0])) * strides[0];
                det.bbox.y = (det.bbox.y + (i / hsizes[0])) * strides[0];
                det.bbox.w = std::exp(det.bbox.w) * strides[0];
                det.bbox.h = std::exp(det.bbox.h) * strides[0];
                //info("x: %d y: %d\n", (i%wsizes[0]), (i/hsizes[0]));
            }
            else if (i < section1_1d)
            {
                int section_i = i - section0_1d;
                //info("i: %d y: %lf i/hsizes[1]: %d stride: %lf\n", i, det.bbox.y, (section_i/hsizes[1]), strides[1]);
                det.bbox.x = (det.bbox.x + (section_i % wsizes[1])) * strides[1];
                det.bbox.y = (det.bbox.y + (section_i / hsizes[1])) * strides[1];
                det.bbox.w = std::exp(det.bbox.w) * strides[1];
                det.bbox.h = std::exp(det.bbox.h) * strides[1];
            }
            else
            {
                int section_i = i - section1_1d;
                //info("i: %d y: %lf i/hsizes[2]: %d stride: %lf\n", i, det.bbox.y, (section_i/hsizes[2]), strides[2]);
                det.bbox.x = (det.bbox.x + (section_i % wsizes[2])) * strides[2];
                det.bbox.y = (det.bbox.y + (section_i / hsizes[2])) * strides[2];
                det.bbox.w = std::exp(det.bbox.w) * strides[2];
                det.bbox.h = std::exp(det.bbox.h) * strides[2];
            }

            for (int j = 0; j < (numClasses); ++j)
            {
                float sig = (static_cast<float>(net.branches[0].modelOutput[bbox_scr_offset + j]) - net.branches[0].zeroPoint) * net.branches[0].scale * objectness;
                det.prob.emplace_back((sig > threshold) ? sig : 0);
            }

            //info("x: %lf y: %lf w: %lf h: %lf\n", det.bbox.x, det.bbox.y, det.bbox.w, det.bbox.h);

            if (num < net.topN || net.topN <= 0)
            {
                detections.emplace_front(det);
                num += 1;
            }
            else if (num == net.topN)
            {
                detections.sort(det_objectness_comparator);
                InsertTopNDetections(detections, det);
                num += 1;
            }
            else
            {
                InsertTopNDetections(detections, det);
            }

        } // if
    } // for net.branches[0].resolution


    if (num > net.topN)
        num -= 1;
}

} /* namespace object_detection */
} /* namespace app */
} /* namespace arm */
```

## src/DetectorPostProcessing.hpp
```c
/*
 * Copyright (c) 2022 Arm Limited. All rights reserved.
 * SPDX-License-Identifier: Apache-2.0
 *
 * Licensed under the Apache License, Version 2.0 (the "License");
 * you may not use this file except in compliance with the License.
 * You may obtain a copy of the License at
 *
 *     http://www.apache.org/licenses/LICENSE-2.0
 *
 * Unless required by applicable law or agreed to in writing, software
 * distributed under the License is distributed on an "AS IS" BASIS,
 * WITHOUT WARRANTIES OR CONDITIONS OF ANY KIND, either express or implied.
 * See the License for the specific language governing permissions and
 * limitations under the License.
 */
#ifndef DETECTOR_POST_PROCESSING_HPP
#define DETECTOR_POST_PROCESSING_HPP

#include "ImageUtils.hpp"
#include "DetectionResult.hpp"
#include "YoloXnanoNu.hpp"

#include <forward_list>

namespace arm
{
namespace app
{
namespace object_detection
{

struct Branch
{
    int resolution;
    int8_t *modelOutput;
    float scale;
    int zeroPoint;
    size_t size;
};

struct Network
{
    int inputWidth;
    int inputHeight;
    int numClasses;
    std::vector<Branch> branches;
    int topN;
};

/**
 * @brief   Helper class to manage tensor post-processing for "object_detection"
 *          output.
 */
class DetectorPostprocessing
{
public:
    /**
     * @brief       Constructor.
     * @param[in]   threshold     Post-processing threshold.
     * @param[in]   nms           Non-maximum Suppression threshold.
     * @param[in]   numClasses    Number of classes.
     * @param[in]   topN          Top N for each class.
     **/
    explicit DetectorPostprocessing(float threshold = 0.5f,
                                    float nms = 0.45f,
                                    int numClasses = 1,
                                    int topN = 0);

    /**
     * @brief       Post processing part of YOLO object detection CNN.
     * @param[in]   imgNetRows      Number of rows in the network input image.
     * @param[in]   imgNetCols      Number of columns in the network input image.
     * @param[in]   imgSrcRows      Number of rows in the orignal input image.
     * @param[in]   imgSrcCols      Number of columns in the oringal input image.
     * @param[in]   modelOutput  Output tensors after CNN invoked.
     * @param[out]  resultsOut   Vector of detected results.
     **/
    void RunPostProcessing(uint32_t imgNetRows,
                           uint32_t imgNetCols,
                           uint32_t imgSrcRows,
                           uint32_t imgSrcCols,
                           TfLiteTensor *modelOutput0,
                           std::vector<DetectionResult> &resultsOut);

private:
    float m_threshold;  /* Post-processing threshold */
    float m_nms;        /* NMS threshold */
    int   m_numClasses; /* Number of classes */
    int   m_topN;       /* TopN */

    /**
     * @brief       Insert the given Detection in the list.
     * @param[in]   detections   List of detections.
     * @param[in]   det          Detection to be inserted.
     **/
    void InsertTopNDetections(std::forward_list<image::Detection> &detections, image::Detection &det);

    /**
     * @brief        Given a Network calculate the detection boxes.
     * @param[in]    net           Network.
     * @param[in]    imageWidth    Original image width.
     * @param[in]    imageHeight   Original image height.
     * @param[in]    threshold     Detections threshold.
     * @param[out]   detections    Detection boxes.
     **/
    void GetNetworkBoxes(Network &net,
                         int imageWidth,
                         int imageHeight,
                         float threshold,
                         std::forward_list<image::Detection> &detections);

    /**
     * @brief       Draw on the given image a bounding box starting at (boxX, boxY).
     * @param[in/out]   imgIn    Image.
     * @param[in]       imWidth    Image width.
     * @param[in]       imHeight   Image height.
     * @param[in]       boxX       Axis X starting point.
     * @param[in]       boxY       Axis Y starting point.
     * @param[in]       boxWidth   Box width.
     * @param[in]       boxHeight  Box height.
     **/
    void DrawBoxOnImage(uint8_t *imgIn,
                        int imWidth,
                        int imHeight,
                        int boxX,
                        int boxY,
                        int boxWidth,
                        int boxHeight);
};

} /* namespace object_detection */
} /* namespace app */
} /* namespace arm */

#endif /* DETECTOR_POST_PROCESSING_HPP */
```

## src/InferenceTask.cpp
```c
/**************************************************************************//**
 * @file     InferenceTask.cpp
 * @version  V0.10
 * @brief    Inference process source code
 * * SPDX-License-Identifier: Apache-2.0
 * @copyright (C) 2022 Nuvoton Technology Corp. All rights reserved.
 ******************************************************************************/

#include "InferenceTask.hpp"
#include <zephyr/logging/log.h>

LOG_MODULE_REGISTER(InferenceTask, LOG_LEVEL_INF);

namespace InferenceProcess
{

InferenceProcess::InferenceProcess(
    Model *model)
    :   m_model(model)
{}

bool InferenceProcess::RunJob(
    object_detection::DetectorPostprocessing *pPostProc,
    int modelCols,
    int mode1Rows,
    int srcImgWidth,
    int srcImgHeight,
    std::vector<object_detection::DetectionResult> *results
)
{
//    LOG_INF("Inference process task run job...");

#if defined(__PROFILE__)
    uint64_t u64StartCycle;
    uint64_t u64EndCycle;

    profiler.StartProfiling("Inference");
#endif

    bool runInf = m_model->RunInference();

#if defined(__PROFILE__)
    profiler.StopProfiling();
    profiler.PrintProfilingResult();
#endif

    TfLiteTensor *modelOutput0 = m_model->GetOutputTensor(0);

#if defined(__PROFILE__)
    u64StartCycle = pmu_get_systick_Count();
#endif

    pPostProc->RunPostProcessing(
        mode1Rows,
        modelCols,
        srcImgHeight,
        srcImgWidth,
        modelOutput0,
        *results);

#if defined(__PROFILE__)
    u64EndCycle = pmu_get_systick_Count();
    LOG_INF("post processing cycles %llu ", (u64EndCycle - u64StartCycle));
#endif

    return runInf;
}

}// namespace InferenceProcess


void inferenceProcessTask(void *pvArgs1, void *pvArgs2, void *pvArgs3)
{
    struct ProcessTaskParams params = *reinterpret_cast<struct ProcessTaskParams *>(pvArgs1);

    InferenceProcess::InferenceProcess inferenceProcess(params.model);

    for (;;)
    {
//		LOG_INF("Inference task is running...");
        xInferenceJob *xJob;
		k_msgq_get(params.queueHandle, &xJob, K_FOREVER);

        inferenceProcess.RunJob(
            xJob->pPostProc,
            xJob->modelCols,
            xJob->mode1Rows,
            xJob->srcImgWidth,
            xJob->srcImgHeight,
            xJob->results
        );

		k_msgq_put(xJob->responseQueue, &xJob, K_FOREVER);
    }
}
```

## src/InferenceTask.hpp
```c
/**************************************************************************//**
 * @file     InferenceProcess.hpp
 * @version  V0.10
 * @brief    Inference process header file
 * * SPDX-License-Identifier: Apache-2.0
 * @copyright (C) 2022 Nuvoton Technology Corp. All rights reserved.
 ******************************************************************************/
#ifndef INFERENCE_TASK_HPP
#define INFERENCE_TASK_HPP

#include <zephyr/kernel.h>

#include "DetectorPostProcessing.hpp" /* Post-processing class. */
#include "Model.hpp"

#if defined(__PROFILE__)
    #include "Profiler.hpp"
#endif

using namespace arm::app;

namespace InferenceProcess
{

class InferenceProcess
{
public:
    InferenceProcess(Model *model);
    bool RunJob(
        object_detection::DetectorPostprocessing *pPostProc,
        int modelCols,
        int mode1Rows,
        int srcImgWidth,
        int srcImgHeight,
        std::vector<object_detection::DetectionResult> *results);
protected:

#if defined(__PROFILE__)
    arm::app::Profiler profiler;
#endif

    Model *m_model = nullptr;
};
}// namespace InferenceProcess

struct ProcessTaskParams
{
    Model *model;
    struct k_msgq *queueHandle;
};

struct xInferenceJob
{
    struct k_msgq *responseQueue;
    object_detection::DetectorPostprocessing *pPostProc;
    int modelCols;
    int mode1Rows;
    int srcImgWidth;
    int srcImgHeight;

    std::vector<object_detection::DetectionResult> *results;
};

void inferenceProcessTask(void *pvArgs1, void *pvArgs2, void *pvArgs3);

#endif
```
